## configs/marshmallow_defconfig
```kconfig
BR2_arm=y
BR2_ARCH="arm"
BR2_ENDIAN="LITTLE"
BR2_GCC_TARGET_TUNE="arm1176jzf-s"
BR2_GCC_TARGET_ARCH="armv6zk"
BR2_GCC_TARGET_ABI="aapcs-linux"
BR2_arm1176jzf_s=y
BR2_ARM_EABI=y

BR2_TOOLCHAIN_BUILDROOT=y

BR2_KERNEL_HEADERS_3_8=y
BR2_DEFAULT_KERNEL_HEADERS="3.8.8"

BR2_UCLIBC_VERSION_0_9_33=y
BR2_UCLIBC_VERSION_STRING="0.9.33.2"
BR2_UCLIBC_CONFIG="board/raspberrypi/uClibc.config"
BR2_UCLIBC_ARM_TYPE="ARM1176JZF_S"

BR2_TOOLCHAIN_BUILDROOT_LARGEFILE=y
BR2_TOOLCHAIN_BUILDROOT_WCHAR=y
BR2_TOOLCHAIN_BUILDROOT_LOCALE=y
BR2_TOOLCHAIN_BUILDROOT_CXX=y
BR2_PTHREADS_NATIVE=y

BR2_TARGET_GENERIC_HOSTNAME="rpi"
BR2_TARGET_GENERIC_ISSUE=""
BR2_ROOTFS_DEVICE_CREATION_DYNAMIC_DEVTMPFS=y
BR2_INIT_BUSYBOX=y

BR2_ROOTFS_SKELETON_CUSTOM=y
BR2_ROOTFS_SKELETON_CUSTOM_PATH="board/raspberrypi/skeleton"
BR2_ROOTFS_POST_BUILD_SCRIPT="board/raspberrypi/postscript.sh board/raspberrypi/mes_postscript.sh"

BR2_PACKAGE_BUSYBOX=y
BR2_BUSYBOX_VERSION_1_20_X=y
BR2_BUSYBOX_VERSION="1.20.2"
BR2_PACKAGE_BUSYBOX_CONFIG="board/raspberrypi/busybox.config"

BR2_PACKAGE_ALSA_UTILS=y
BR2_PACKAGE_ALSA_UTILS_ALSACTL=y
BR2_PACKAGE_ALSA_UTILS_ALSAMIXER=y
BR2_PACKAGE_ALSA_LIB=y

BR2_PACKAGE_LIBVORBIS=y

BR2_PACKAGE_ZLIB=y

BR2_PACKAGE_OPENSSL=y

BR2_PACKAGE_HAS_OPENGL_EGL=y
BR2_PACKAGE_HAS_OPENGL_ES=y
BR2_PACKAGE_HAS_OPENVG=y

BR2_PACKAGE_LIBOGG=y

BR2_PACKAGE_NTP=y
BR2_PACKAGE_NTP_NTPD=y
BR2_PACKAGE_NTP_NTPDATE=y

BR2_PACKAGE_OPENSSH=y

BR2_PACKAGE_RPI_USERLAND=y

BR2_PACKAGE_MARSHMALLOW_H=y
BR2_PACKAGE_MARSHMALLOW_H_DEMOS=y

BR2_TARGET_ROOTFS_TAR=y
BR2_TARGET_ROOTFS_TAR_NONE=y
BR2_TARGET_ROOTFS_TAR_OPTIONS=""

BR2_TARGET_RPI=y

BR2_LINUX_KERNEL=y
BR2_LINUX_KERNEL_CUSTOM_VERSION=y
BR2_LINUX_KERNEL_CUSTOM_VERSION_VALUE="3.8.8"
BR2_LINUX_KERNEL_VERSION="3.8.8"
BR2_LINUX_KERNEL_PATCH="http://dl.guillermoamaral.com/rpi/kernel-3.8.8.patch"
BR2_LINUX_KERNEL_USE_CUSTOM_CONFIG=y
BR2_LINUX_KERNEL_CUSTOM_CONFIG_FILE="board/raspberrypi/mes_linux_config"
BR2_LINUX_KERNEL_ZIMAGE=y
```

## configs/picopi2_defconfig
```kconfig
BR2_arm=y
BR2_cortex_a7=y
BR2_ARM_EABIHF=y
BR2_ARM_FPU_NEON_VFPV4=y

# BR2_ENABLE_LOCALE_PURGE is not set
# BR2_TARGET_GENERIC_REMOUNT_ROOTFS_RW is not set
BR2_GCC_ENABLE_LTO=y
BR2_OPTIMIZE_3=y
BR2_ROOTFS_DEVICE_CREATION_DYNAMIC_EUDEV=y
BR2_ROOTFS_OVERLAY="board/picopi2/overlay"
BR2_TOOLCHAIN_BUILDROOT_CXX=y
BR2_TOOLCHAIN_BUILDROOT_GLIBC=y
BR2_TOOLCHAIN_BUILDROOT_VENDOR="picopi"

BR2_TARGET_GENERIC_GETTY_PORT="ttyAMA0"
BR2_TARGET_GENERIC_HOSTNAME="rpi"
BR2_TARGET_GENERIC_ISSUE=""

BR2_KERNEL_HEADERS_VERSION=y
BR2_DEFAULT_KERNEL_VERSION="4.9.76"
BR2_PACKAGE_HOST_LINUX_HEADERS_CUSTOM_4_9=y

BR2_LINUX_KERNEL=y
BR2_LINUX_KERNEL_CUSTOM_GIT=y
BR2_LINUX_KERNEL_CUSTOM_REPO_URL="https://github.com/raspberrypi/linux.git"
BR2_LINUX_KERNEL_CUSTOM_REPO_VERSION="rpi-4.9.y"
BR2_LINUX_KERNEL_DEFCONFIG="bcm2709"
BR2_LINUX_KERNEL_USE_DEFCONFIG=y
BR2_LINUX_KERNEL_CONFIG_FRAGMENT_FILES="board/picopi2/linux.fragment"

BR2_LINUX_KERNEL_DTS_SUPPORT=y
BR2_LINUX_KERNEL_INTREE_DTS_NAME="bcm2709-rpi-2-b"

# Filesystem / image
# BR2_TARGET_ROOTFS_TAR is not set
BR2_ROOTFS_POST_IMAGE_SCRIPT="board/picopi2/post-image.sh"
BR2_ROOTFS_POST_SCRIPT_ARGS=""
BR2_TARGET_ROOTFS_INITRAMFS=y

# BR2_PACKAGE_RPI_FIRMWARE_INSTALL_DTB_OVERLAYS is not set
BR2_PACKAGE_ALSA_LIB=y
BR2_PACKAGE_KBD=y
BR2_PACKAGE_RPI_FBCP=y
BR2_PACKAGE_RPI_FIRMWARE=y
BR2_PACKAGE_RPI_USERLAND=y
BR2_PACKAGE_SDL2=y
BR2_PACKAGE_SDL2_OPENGLES=y
BR2_PACKAGE_WIRINGPI=y
```

## configs/raspberrypi0_defconfig
```kconfig
BR2_arm=y
BR2_arm1176jzf_s=y
BR2_ARM_EABIHF=y
BR2_ARM_FPU_VFPV2=y

BR2_ROOTFS_OVERLAY="board/raspberrypi/overlay"
BR2_TARGET_GENERIC_GETTY_PORT="ttyAMA0"
BR2_TARGET_GENERIC_HOSTNAME="rpi"
BR2_TARGET_GENERIC_ISSUE=""

BR2_KERNEL_HEADERS_VERSION=y
BR2_DEFAULT_KERNEL_VERSION="4.4.50"
# Linux headers same as kernel, a 4.4 series
BR2_PACKAGE_HOST_LINUX_HEADERS_CUSTOM_4_4=y

BR2_LINUX_KERNEL=y
BR2_LINUX_KERNEL_CUSTOM_GIT=y
BR2_LINUX_KERNEL_CUSTOM_REPO_URL="https://github.com/raspberrypi/linux.git"
BR2_LINUX_KERNEL_CUSTOM_REPO_VERSION="raspberrypi-kernel_1.20170303-1"
BR2_LINUX_KERNEL_DEFCONFIG="bcmrpi"
BR2_LINUX_KERNEL_USE_DEFCONFIG=y

# Build the DTBs for A/B from the kernel sources: the zero is the same
# as the A+ model, just in a different form-factor
BR2_LINUX_KERNEL_DTS_SUPPORT=y
BR2_LINUX_KERNEL_INTREE_DTS_NAME="bcm2708-rpi-b-plus"

BR2_PACKAGE_RPI_FIRMWARE=y
# BR2_PACKAGE_RPI_FIRMWARE_INSTALL_DTB_OVERLAYS is not set

# Required tools to create the SD image
BR2_PACKAGE_HOST_DOSFSTOOLS=y
BR2_PACKAGE_HOST_GENIMAGE=y
BR2_PACKAGE_HOST_MTOOLS=y

# Filesystem / image
BR2_TARGET_ROOTFS_EXT2=y
BR2_TARGET_ROOTFS_EXT2_4=y
# BR2_TARGET_ROOTFS_TAR is not set
BR2_ROOTFS_POST_BUILD_SCRIPT="board/raspberrypi0/post-build.sh"
BR2_ROOTFS_POST_IMAGE_SCRIPT="board/raspberrypi0/post-image.sh"
```

## configs/raspberrypi2_defconfig
```kconfig
BR2_arm=y
BR2_cortex_a7=y
BR2_ARM_EABIHF=y
BR2_ARM_FPU_NEON_VFPV4=y

BR2_TOOLCHAIN_BUILDROOT_CXX=y

BR2_ROOTFS_OVERLAY="board/raspberrypi/overlay"
BR2_TARGET_GENERIC_GETTY_PORT="ttyAMA0"
BR2_TARGET_GENERIC_HOSTNAME="rpi"
BR2_TARGET_GENERIC_ISSUE=""

BR2_KERNEL_HEADERS_VERSION=y
BR2_DEFAULT_KERNEL_VERSION="4.1.14"
BR2_PACKAGE_HOST_LINUX_HEADERS_CUSTOM_4_1=y

BR2_LINUX_KERNEL=y
BR2_LINUX_KERNEL_CUSTOM_GIT=y
BR2_LINUX_KERNEL_CUSTOM_REPO_URL="git://github.com/raspberrypi/linux.git"
BR2_LINUX_KERNEL_CUSTOM_REPO_VERSION="rpi-4.1.y"
BR2_LINUX_KERNEL_DEFCONFIG="bcm2709"
BR2_LINUX_KERNEL_USE_DEFCONFIG=y
BR2_LINUX_KERNEL_ZIMAGE=y

BR2_LINUX_KERNEL_DTS_SUPPORT=y
BR2_LINUX_KERNEL_INTREE_DTS_NAME="bcm2709-rpi-2-b"

BR2_PACKAGE_RPI_FIRMWARE=y
# BR2_PACKAGE_RPI_FIRMWARE_INSTALL_DTB_OVERLAYS is not set
```

## configs/raspberrypi3_64_defconfig
```kconfig
BR2_aarch64=y
BR2_cortex_a53=y
BR2_ARM_FPU_VFPV4=y

BR2_TOOLCHAIN_BUILDROOT_CXX=y

BR2_SYSTEM_DHCP="eth0"

BR2_ROOTFS_OVERLAY="board/raspberrypi/overlay"
BR2_TARGET_GENERIC_GETTY_PORT="ttyAMA0"
BR2_TARGET_GENERIC_HOSTNAME="rpi"
BR2_TARGET_GENERIC_ISSUE=""

BR2_KERNEL_HEADERS_VERSION=y
BR2_DEFAULT_KERNEL_VERSION="4.9.41"
BR2_PACKAGE_HOST_LINUX_HEADERS_CUSTOM_4_9=y

BR2_LINUX_KERNEL=y
BR2_LINUX_KERNEL_CUSTOM_GIT=y
BR2_LINUX_KERNEL_CUSTOM_REPO_URL="https://github.com/raspberrypi/linux.git"
BR2_LINUX_KERNEL_CUSTOM_REPO_VERSION="raspberrypi-kernel_1.20170811-1"
BR2_LINUX_KERNEL_DEFCONFIG="bcmrpi3"
BR2_LINUX_KERNEL_USE_DEFCONFIG=y

# Build the DTB from the kernel sources
BR2_LINUX_KERNEL_DTS_SUPPORT=y
BR2_LINUX_KERNEL_INTREE_DTS_NAME="broadcom/bcm2710-rpi-3-b broadcom/bcm2837-rpi-3-b"

BR2_PACKAGE_RPI_FIRMWARE=y
# BR2_PACKAGE_RPI_FIRMWARE_INSTALL_DTB_OVERLAYS is not set
BR2_PACKAGE_RPI_USERLAND=y

# Required tools to create the SD image
BR2_PACKAGE_HOST_DOSFSTOOLS=y
BR2_PACKAGE_HOST_GENIMAGE=y
BR2_PACKAGE_HOST_MTOOLS=y

# Filesystem / image
BR2_TARGET_ROOTFS_EXT2=y
BR2_TARGET_ROOTFS_EXT2_4=y
BR2_TARGET_ROOTFS_EXT2_SIZE="120M"
# BR2_TARGET_ROOTFS_TAR is not set
BR2_ROOTFS_POST_BUILD_SCRIPT="board/raspberrypi3-64/post-build.sh"
BR2_ROOTFS_POST_IMAGE_SCRIPT="board/raspberrypi3-64/post-image.sh"
BR2_ROOTFS_POST_SCRIPT_ARGS="--aarch64"
```

## configs/raspberrypi_defconfig
```kconfig
BR2_arm=y
BR2_arm1176jzf_s=y
BR2_ARM_EABIHF=y
BR2_ARM_FPU_VFPV2=y

BR2_TOOLCHAIN_BUILDROOT_CXX=y

BR2_ROOTFS_SKELETON_CUSTOM=y
BR2_ROOTFS_SKELETON_CUSTOM_PATH="board/raspberrypi/skeleton"
BR2_TARGET_GENERIC_GETTY_PORT="ttyAMA0"
BR2_TARGET_GENERIC_HOSTNAME="rpi"
BR2_TARGET_GENERIC_ISSUE=""

BR2_KERNEL_HEADERS_VERSION=y
BR2_DEFAULT_KERNEL_VERSION="4.0.1"
BR2_PACKAGE_HOST_LINUX_HEADERS_CUSTOM_4_0=y

BR2_LINUX_KERNEL=y
BR2_LINUX_KERNEL_CUSTOM_GIT=y
BR2_LINUX_KERNEL_CUSTOM_REPO_URL="git://github.com/raspberrypi/linux.git"
BR2_LINUX_KERNEL_CUSTOM_REPO_VERSION="rpi-4.0.y"
BR2_LINUX_KERNEL_USE_DEFCONFIG=y
BR2_LINUX_KERNEL_DEFCONFIG="bcmrpi"
BR2_LINUX_KERNEL_ZIMAGE=y

BR2_PACKAGE_RPI_FIRMWARE=y
```

## package/libepoxy/Config.in
```kconfig
config BR2_PACKAGE_LIBEPOXY
	bool "libepoxy"
	help
	  Epoxy is a library for handling OpenGL function pointer management for you
	
	  https://github.com/anholt/libepoxy
```

## package/marshmallow_h/Config.in
```kconfig
config BR2_PACKAGE_MARSHMALLOW_H
	bool "marshmallow_h"
	help
	  Marshmallow Game Engine

	  https://github.com/gamaral/marshmallow_h

if BR2_PACKAGE_MARSHMALLOW_H

menu "Marshmallow selection"

config BR2_PACKAGE_MARSHMALLOW_H_DEMOS
	bool "marshmallow_h_demos"
	default y
	depends on BR2_PACKAGE_MARSHMALLOW_H
	help
	  Build and install Marshmallow Game Engine demos

endmenu

endif
```

## package/openal-soft/Config.in
```kconfig
config BR2_PACKAGE_OPENAL_SOFT
        bool "openal-soft"
        help
          OpenAL Soft is an LGPL-licensed, cross-platform, software
          implementation of the OpenAL 3D audio API.

          http://kcat.strangesoft.net/openal.html

if BR2_PACKAGE_OPENAL_SOFT

menu "OpenAL selection"

config BR2_PACKAGE_OPENAL_SOFT_ALSA
	bool "alsa"
	default y
	depends on BR2_PACKAGE_ALSA_LIB

config BR2_PACKAGE_OPENAL_SOFT_OSS
	bool "oss"
	default n

config BR2_PACKAGE_OPENAL_SOFT_UTILS
	bool "utils"
	default n

endmenu

endif
```

## package/openal/Config.in
```kconfig
menuconfig BR2_PACKAGE_OPENAL
	bool "openal"
	help
	  OpenAL Soft

	  http://kcat.strangesoft.net/openal.html
```

## package/rpi-fbcp/Config.in
```kconfig
config BR2_PACKAGE_RPI_FBCP
	bool "rpi-fbcp"
	depends on BR2_arm
	depends on BR2_PACKAGE_RPI_USERLAND
	help
	  Raspberry Pi utility. Used for mirror primary framebuffer to
	  secondary framebuffer.

	  https://github.com/tasanakorn/rpi-fbcp

comment "rpi-fbc needs rpi-userland"
	depends on BR2_arm
	depends on !BR2_PACKAGE_RPI_USERLAND
```

## package/x11r7/xdriver_xf86-video-modesetting/Config.in
```kconfig
config BR2_PACKAGE_XDRIVER_XF86_VIDEO_MODESETTING
	bool "xf86-video-modesetting"
	select BR2_PACKAGE_XPROTO_FONTSPROTO
	select BR2_PACKAGE_XPROTO_RANDRPROTO
	select BR2_PACKAGE_XPROTO_RENDERPROTO
	select BR2_PACKAGE_XPROTO_VIDEOPROTO
	select BR2_PACKAGE_XPROTO_XPROTO
	help
	  video driver for generic KMS kernel modesetting device
```

## package/x11r7/xdriver_xf86-video-udlfb/Config.in
```kconfig
config BR2_PACKAGE_XDRIVER_XF86_VIDEO_UDLFB
	bool "xf86-video-udlfb"
	select BR2_PACKAGE_XPROTO_FONTSPROTO
	select BR2_PACKAGE_XPROTO_RANDRPROTO
	select BR2_PACKAGE_XPROTO_RENDERPROTO
	select BR2_PACKAGE_XPROTO_VIDEOPROTO
	select BR2_PACKAGE_XPROTO_XPROTO
	help
	  video driver for displaylink USB2 udlfb device
```

## package/xdotool/Config.in
```kconfig
config BR2_PACKAGE_XDOTOOL
	bool "xdotool"
	select BR2_PACKAGE_XLIB_LIBXTST
	depends on BR2_PACKAGE_XORG7
	help
	  fake keyboard/mouse input, window management, and more

	  http://www.semicomplete.com/projects/xdotool/ 
```
